## buildroot/configs/milkv-duos-musl-riscv64-emmc_defconfig
```kconfig
BR2_riscv=y
BR2_TOOLCHAIN_EXTERNAL=y
BR2_TOOLCHAIN_EXTERNAL_CUSTOM=y
BR2_TOOLCHAIN_EXTERNAL_PATH="$(TOPDIR)/../host-tools/gcc/riscv64-linux-musl-x86_64"
BR2_TOOLCHAIN_EXTERNAL_CUSTOM_PREFIX="riscv64-unknown-linux-musl"
BR2_TOOLCHAIN_EXTERNAL_GCC_10=y
BR2_TOOLCHAIN_EXTERNAL_HEADERS_5_10=y
BR2_TOOLCHAIN_EXTERNAL_CUSTOM_MUSL=y
BR2_TOOLCHAIN_EXTERNAL_CXX=y
BR2_TOOLCHAIN_EXTERNAL_OPENMP=y
BR2_TARGET_LDFLAGS="-march=rv64imafdcv0p7xthead -mcpu=c906fdv -mabi=lp64d -mcmodel=medany"
BR2_OPTIMIZE_S=y
BR2_PER_PACKAGE_DIRECTORIES=y
BR2_TARGET_GENERIC_HOSTNAME="milkv-duos-ntp"
BR2_TARGET_GENERIC_ISSUE="Welcome to Milk-V DuoS RISCV64 eMMC"
BR2_TARGET_GENERIC_ROOT_PASSWD="milkv"
BR2_TARGET_TZ_INFO=y
BR2_TARGET_LOCALTIME="Asia/Shanghai"
BR2_ROOTFS_OVERLAY="board/milkv/milkv-duos-musl-riscv64-emmc/overlay"
BR2_PACKAGE_BUSYBOX_SHOW_OTHERS=y
BR2_PACKAGE_BZIP2=y
BR2_PACKAGE_GZIP=y
BR2_PACKAGE_P7ZIP=y
BR2_PACKAGE_UNRAR=y
BR2_PACKAGE_UNZIP=y
BR2_PACKAGE_XZ=y
BR2_PACKAGE_ZIP=y
BR2_PACKAGE_ZSTD=y
BR2_PACKAGE_LSOF=y
BR2_PACKAGE_TREE=y
BR2_PACKAGE_E2FSPROGS=y
BR2_PACKAGE_E2FSPROGS_RESIZE2FS=y
BR2_PACKAGE_EVTEST=y
BR2_PACKAGE_GPSD=y
BR2_PACKAGE_GPSD_DEVICES="/dev/ttyS1 /dev/pps0"
BR2_PACKAGE_GPSD_USER=y
BR2_PACKAGE_GPSD_USER_VALUE="root"
BR2_PACKAGE_GPSD_GROUP=y
BR2_PACKAGE_GPSD_GROUP_VALUE="root"
BR2_PACKAGE_I2C_TOOLS=y
BR2_PACKAGE_MINICOM=y
BR2_PACKAGE_PARTED=y
BR2_PACKAGE_SPI_TOOLS=y
BR2_PACKAGE_CA_CERTIFICATES=y
BR2_PACKAGE_OPENSSL=y
BR2_PACKAGE_LIBOPENSSL_BIN=y
BR2_PACKAGE_LIBOPENSSL_ENGINES=y
BR2_PACKAGE_C_PERIPHERY=y
BR2_PACKAGE_DTC=y
BR2_PACKAGE_DTC_PROGRAMS=y
BR2_PACKAGE_LIBUSB=y
BR2_PACKAGE_LIBUSB_EXAMPLES=y
BR2_PACKAGE_LIBCURL=y
BR2_PACKAGE_LIBCURL_CURL=y
BR2_PACKAGE_LIBCURL_VERBOSE=y
BR2_PACKAGE_LIBCURL_WEBSOCKETS_SUPPORT=y
BR2_PACKAGE_LIBNL=y
BR2_PACKAGE_ELL=y
BR2_PACKAGE_MPFR=y
BR2_PACKAGE_PCRE2=y
BR2_PACKAGE_READLINE=y
BR2_PACKAGE_DHCPCD=y
BR2_PACKAGE_DNSMASQ=y
BR2_PACKAGE_DROPBEAR=y
BR2_PACKAGE_ETHTOOL=y
BR2_PACKAGE_GESFTPSERVER=y
BR2_PACKAGE_IFTOP=y
BR2_PACKAGE_NETCAT=y
BR2_PACKAGE_NTP=y
BR2_PACKAGE_NTP_NTP_SHM_CLK=y
BR2_PACKAGE_NTP_NTPD_ATOM_PPS=y
BR2_PACKAGE_NTP_NTPDATE=y
BR2_PACKAGE_NTP_NTPQ=y
BR2_PACKAGE_NTP_NTPTIME=y
BR2_PACKAGE_NTP_TICKADJ=y
BR2_PACKAGE_FILE=y
BR2_PACKAGE_CVI_PINMUX=y
BR2_PACKAGE_CVI_PINMUX_SG200X=y
BR2_PACKAGE_DUO_PINMUX=y
BR2_PACKAGE_DUO_PINMUX_DUOS=y
BR2_PACKAGE_DUO_WIRINGX=y
BR2_PACKAGE_COREUTILS=y
BR2_PACKAGE_HTOP=y
BR2_PACKAGE_KMOD=y
BR2_PACKAGE_UTIL_LINUX_BINARIES=y
BR2_PACKAGE_UTIL_LINUX_RFKILL=y
BR2_PACKAGE_VIM=y
# BR2_PACKAGE_VIM_RUNTIME is not set
BR2_TARGET_ROOTFS_EXT2=y
BR2_TARGET_ROOTFS_EXT2_4=y
BR2_TARGET_ROOTFS_EXT2_SIZE="786432K"
BR2_TARGET_ROOTFS_TAR_XZ=y
BR2_PACKAGE_HOST_GENIMAGE=y
BR2_PACKAGE_HOST_PYTHON3=y
```
